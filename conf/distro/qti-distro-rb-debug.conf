## conf/layer.conf
```bitbake
BBPATH .= ":${LAYERDIR}"

BBFILE_COLLECTIONS        += "qti-distro"
BBFILE_PATTERN_qti-distro := "^${LAYERDIR}/"
BBFILE_PRIORITY_qti-distro = "10"

LAYERSERIES_COMPAT_qti-distro = "scarthgap"

BBFILES += " ${LAYERDIR}/recipes-*/*/*.bb \
             ${LAYERDIR}/recipes-*/*/*.bbappend"
```
